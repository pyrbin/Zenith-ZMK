/*
 * Combo definitions for 42-key TOTEM variant
 * Optimized for Swedish keyboard layout
 *
 * Combos provide fast access to symbols without a dedicated layer.
 *
 * Key positions reference (see key-labels-42.h):
 *
 * ╭──────────────────────────────────╮   ╭──────────────────────────────────╮
 * │ LT5  LT4  LT3  LT2  LT1  LT0    │   │ RT0  RT1  RT2  RT3  RT4  RT5    │
 * │ LM5  LM4  LM3  LM2  LM1  LM0    │   │ RM0  RM1  RM2  RM3  RM4  RM5    │
 * │ LB5  LB4  LB3  LB2  LB1  LB0    │   │ RB0  RB1  RB2  RB3  RB4  RB5    │
 * ╰───────────╮ LH2  LH1  LH0       │   │      RH0  RH1  RH2 ╭────────────╯
 *             ╰─────────────────────╯   ╰──────────────────────╯
 *
 * Combo Layout (symbol at edge between combo keys):
 *
 * ╭──────┬─────────────┬──────┬──────┬──────╮   ╭──────┬──────┬──────┬──────┬──────┬──────╮
 * │      │  Q  ESC  W  │  E   │  R   │  T   │   │  Y   │  U   │  I   │  O   │      │      │
 * ├──────┼──────┼───@──┼───#──┼───$──┼───%──┤   ├───^──┼───+──┼───*──┼───&──┼──────┼──────┤
 * │      │  A   │  S   ↶  D   ↷ F    │  G   │   │  H   │  J  (<  K  >)  L   │      │      │
 * ├──────┼──────┼───`──┼───\──┼───=──┼───~──┤   ├───_──┼───-──┼───/──┼───|──┼──────┼──────┤
 * │      │  Z   │  X  📋  C  📌  V   │  B   │   │  N   │  M  [{  ;, }]  .:  │      │      │
 * ╰──────┴──────┴──────┴──────┴──────┴──────╯   ╰──────┴──────┴──────┴──────┴──────┴──────╯
 *
 * ↶ = undo, ↷ = redo, 📋 = copy/cut (tap dance), 📌 = paste
 * (< >) = mod-morph: tap = () | shift = <>
 * [{ }] = mod-morph: tap = [] | shift = {}
 */

#include <dt-bindings/zmk/keys.h>
#include "swedish-keys.h"

/* Combo timing settings */
#define COMBO_TERM_FAST 18
#define COMBO_TERM_SLOW 30
#define COMBO_IDLE_FAST 150
#define COMBO_IDLE_SLOW 50

/* Macro for defining combos with consistent settings */
#define ZMK_COMBO(NAME, BINDINGS, KEYPOS, LAYERS, TERM, IDLE) \
    combo_##NAME { \
        timeout-ms = <TERM>; \
        require-prior-idle-ms = <IDLE>; \
        key-positions = <KEYPOS>; \
        bindings = <BINDINGS>; \
        layers = <LAYERS>; \
    };

/ {
    combos {
        compatible = "zmk,combos";

        /*
         * Horizontal combos - Left hand (red)
         */

        /* ESC: Q + W (top row) */
        ZMK_COMBO(esc, &kp ESC, LT4 LT3, DEF NAV NUM GAME, COMBO_TERM_FAST, COMBO_IDLE_FAST)

        /* ↶ Undo: S + D (home row) */
        ZMK_COMBO(undo, &kp LC(Z), LM3 LM2, DEF NAV NUM, COMBO_TERM_FAST, COMBO_IDLE_FAST)

        /* ↷ Redo: D + F (home row) */
        ZMK_COMBO(redo, &kp LC(Y), LM2 LM1, DEF NAV NUM, COMBO_TERM_FAST, COMBO_IDLE_FAST)

        /* 📋 Copy/Cut: X + C (bottom row) */
        ZMK_COMBO(copy, &copy_cut, LB3 LB2, DEF NAV NUM, COMBO_TERM_FAST, COMBO_IDLE_FAST)

        /* 📌 Paste: C + V (bottom row) */
        ZMK_COMBO(paste, &kp LC(V), LB2 LB1, DEF NAV NUM, COMBO_TERM_FAST, COMBO_IDLE_FAST)

        /*
         * Horizontal combos - Right hand (blue, mod-morph)
         */

        /* (< : J + K (home row) — tap = ( | shift = < */
        ZMK_COMBO(lpar, &lpar_lt, RM1 RM2, DEF NAV NUM, COMBO_TERM_FAST, COMBO_IDLE_FAST)

        /* >) : K + L (home row) — tap = ) | shift = > */
        ZMK_COMBO(rpar, &rpar_gt, RM2 RM3, DEF NAV NUM, COMBO_TERM_FAST, COMBO_IDLE_FAST)

        /* [{ : M + ;, (bottom row) — tap = [ | shift = { */
        ZMK_COMBO(lbkt, &lbkt_lbrc, RB1 RB2, DEF NAV NUM, COMBO_TERM_FAST, COMBO_IDLE_FAST)

        /* }] : ;, + .: (bottom row) — tap = ] | shift = } */
        ZMK_COMBO(rbkt, &rbkt_rbrc, RB2 RB3, DEF NAV NUM, COMBO_TERM_FAST, COMBO_IDLE_FAST)

        /*
         * Vertical combos - Left hand (top → home)
         */

        /* @ : W + S (column 3) */
        ZMK_COMBO(at, SWE_AT, LT3 LM3, DEF NAV NUM, COMBO_TERM_SLOW, COMBO_IDLE_SLOW)

        /* # : E + D (column 2) */
        ZMK_COMBO(hash, SWE_HASH, LT2 LM2, DEF NAV NUM, COMBO_TERM_SLOW, COMBO_IDLE_SLOW)

        /* $ : R + F (column 1) */
        ZMK_COMBO(dllr, SWE_DLLR, LT1 LM1, DEF NAV NUM, COMBO_TERM_SLOW, COMBO_IDLE_SLOW)

        /* % : T + G (column 0) */
        ZMK_COMBO(prcnt, SWE_PERC, LT0 LM0, DEF NAV NUM, COMBO_TERM_SLOW, COMBO_IDLE_SLOW)

        /*
         * Vertical combos - Left hand (home → bottom)
         */

        /* ` : S + X (column 3) */
        ZMK_COMBO(grave, SWE_GRAVE, LM3 LB3, DEF NAV NUM, COMBO_TERM_SLOW, COMBO_IDLE_SLOW)

        /* \ : D + C (column 2) */
        ZMK_COMBO(bslh, SWE_BSLH, LM2 LB2, DEF NAV NUM, COMBO_TERM_SLOW, COMBO_IDLE_SLOW)

        /* = : F + V (column 1) */
        ZMK_COMBO(equal, SWE_EQ, LM1 LB1, DEF NAV NUM, COMBO_TERM_SLOW, COMBO_IDLE_SLOW)

        /* ~ : G + B (column 0) */
        ZMK_COMBO(tilde, SWE_TILDE, LM0 LB0, DEF NAV NUM, COMBO_TERM_SLOW, COMBO_IDLE_SLOW)

        /*
         * Vertical combos - Right hand (top → home)
         */

        /* ^ : Y + H (column 0) */
        ZMK_COMBO(caret, SWE_CARET, RT0 RM0, DEF NAV NUM, COMBO_TERM_SLOW, COMBO_IDLE_SLOW)

        /* + : U + J (column 1) */
        ZMK_COMBO(plus, SWE_PLUS, RT1 RM1, DEF NAV NUM, COMBO_TERM_SLOW, COMBO_IDLE_SLOW)

        /* * : I + K (column 2) */
        ZMK_COMBO(star, SWE_STAR, RT2 RM2, DEF NAV NUM, COMBO_TERM_SLOW, COMBO_IDLE_SLOW)

        /* & : O + L (column 3) */
        ZMK_COMBO(amps, SWE_AMPER, RT3 RM3, DEF NAV NUM, COMBO_TERM_SLOW, COMBO_IDLE_SLOW)

        /*
         * Vertical combos - Right hand (home → bottom)
         */

        /* _ : H + N (column 0) */
        ZMK_COMBO(under, SWE_UNDER, RM0 RB0, DEF NAV NUM, COMBO_TERM_SLOW, COMBO_IDLE_SLOW)

        /* - : J + M (column 1) */
        ZMK_COMBO(minus, SWE_MINUS, RM1 RB1, DEF NAV NUM, COMBO_TERM_SLOW, COMBO_IDLE_SLOW)

        /* / : K + ;, (column 2) */
        ZMK_COMBO(fslh, SWE_FSLH, RM2 RB2, DEF NAV NUM, COMBO_TERM_SLOW, COMBO_IDLE_SLOW)

        /* | : L + .: (column 3) */
        ZMK_COMBO(pipe, SWE_PIPE, RM3 RB3, DEF NAV NUM, COMBO_TERM_SLOW, COMBO_IDLE_SLOW)

        /*
         * Gaming layer toggle - both outer top keys
         */
        ZMK_COMBO(gaming_toggle, &tog GAME, LT5 RT5, DEF GAME, COMBO_TERM_SLOW, COMBO_IDLE_SLOW)

        /*
         * Caps word - both inner bottom keys
         */
        ZMK_COMBO(caps_word, &caps_word, LB0 RB0, DEF NAV NUM, COMBO_TERM_SLOW, COMBO_IDLE_SLOW)
    };
};
