/*
 * Custom behaviors for Zenith-ZMK
 * Ported from urob's zmk-config with adaptations for 42-key layout
 *
 * Features:
 * - Timeless homerow mods (no misfires, no delays)
 * - Magic shift (repeat/sticky-shift/capsword on one key)
 * - Smart num layer (num_word + tap dance)
 * - Alt+Tab swapper
 * - Mod-morphs for punctuation
 * - Swedish keyboard layout support
 */

#include <behaviors.dtsi>
#include <behaviors/num_word.dtsi>
#include <dt-bindings/zmk/keys.h>

/* Swedish keyboard layout support */
#include "swedish-keys.h"

/* Global timing settings */
#define QUICK_TAP_MS 175

/* Sticky key settings */
&sk {
    release-after-ms = <900>;
    quick-release;
};

/* Sticky layer settings - allow mods to chord across sticky layers */
&sl {
    ignore-modifiers;
};

/* Layer-tap settings */
&lt {
    flavor = "balanced";
    tapping-term-ms = <200>;
    quick-tap-ms = <QUICK_TAP_MS>;
};

/* Mod-tap settings for nav cluster */
&mt {
    flavor = "tap-preferred";
    tapping-term-ms = <220>;
    quick-tap-ms = <220>;
    hold-trigger-key-positions = <0>;
};

/*
 * Homerow Mods - "Timeless" configuration
 *
 * Key features:
 * - require-prior-idle-ms: Prevents accidental mod activation during fast typing
 * - hold-trigger-on-release: Better for rolling keypresses
 * - hold-trigger-key-positions: Only trigger hold on opposite hand keys
 */

#define MAKE_HRM(NAME, HOLD, TAP, TRIGGER_POS) \
    / { \
        behaviors { \
            NAME: NAME { \
                compatible = "zmk,behavior-hold-tap"; \
                #binding-cells = <2>; \
                flavor = "balanced"; \
                tapping-term-ms = <280>; \
                quick-tap-ms = <QUICK_TAP_MS>; \
                require-prior-idle-ms = <150>; \
                hold-trigger-on-release; \
                hold-trigger-key-positions = <TRIGGER_POS>; \
                bindings = <HOLD>, <TAP>; \
            }; \
        }; \
    };

/* Left-hand HRMs - trigger on right-hand keys and thumbs */
MAKE_HRM(hml, &kp, &kp, KEYS_R THUMBS)

/* Right-hand HRMs - trigger on left-hand keys and thumbs */
MAKE_HRM(hmr, &kp, &kp, KEYS_L THUMBS)

/*
 * Magic Shift
 *
 * Tap: repeat after alpha, else sticky-shift
 * Shift + tap / double-tap: caps-word
 * Hold: shift
 */

/ {
    behaviors {
        magic_shift: magic_shift {
            compatible = "zmk,behavior-hold-tap";
            #binding-cells = <2>;
            flavor = "balanced";
            tapping-term-ms = <200>;
            quick-tap-ms = <QUICK_TAP_MS>;
            bindings = <&kp>, <&magic_shift_tap>;
        };

        magic_shift_tap: magic_shift_tap {
            compatible = "zmk,behavior-mod-morph";
            #binding-cells = <0>;
            bindings = <&shift_repeat>, <&caps_word>;
            mods = <(MOD_LSFT)>;
        };

        shift_repeat: shift_repeat {
            compatible = "zmk,behavior-adaptive-key";
            #binding-cells = <0>;
            bindings = <&sk LSHFT>;
            repeat {
                trigger-keys = <A B C D E F G H I J K L M N O P Q R S T U V W X Y Z>;
                bindings = <&key_repeat>;
                max-prior-idle-ms = <1200>;
                strict-modifiers;
            };
        };
    };
};

/*
 * Smart Num Layer
 *
 * Tap: num-word (auto-deactivates after non-number key)
 * Double-tap: sticky num-layer
 * Hold: num-layer
 */

/ {
    behaviors {
        smart_num: smart_num {
            compatible = "zmk,behavior-hold-tap";
            #binding-cells = <2>;
            flavor = "balanced";
            tapping-term-ms = <200>;
            quick-tap-ms = <QUICK_TAP_MS>;
            bindings = <&mo>, <&num_dance>;
        };

        num_dance: num_dance {
            compatible = "zmk,behavior-tap-dance";
            #binding-cells = <0>;
            tapping-term-ms = <200>;
            bindings = <&num_word NUM>, <&sl NUM>;
        };
    };
};

/*
 * Alt+Tab Swapper
 *
 * First press: hold Alt, tap Tab
 * Subsequent presses: tap Tab (Alt still held)
 * Release: release Alt
 */

/ {
    behaviors {
        swapper: swapper {
            compatible = "zmk,behavior-tri-state";
            #binding-cells = <0>;
            bindings = <&kt LALT>, <&kp TAB>, <&kt LALT>;
            ignored-key-positions = <LT3 RT3 RM1 RM2 RM3>;
        };
    };
};

/*
 * Mod-Morphs for punctuation (Swedish keyboard layout)
 */

/ {
    behaviors {
        /* Comma: tap = , | shift = ; (Swedish layout) */
        comma_morph: comma_morph {
            compatible = "zmk,behavior-mod-morph";
            #binding-cells = <0>;
            bindings = <&kp COMMA>, <&comma_inner>;
            mods = <(MOD_LSFT | MOD_RSFT)>;
        };
        comma_inner: comma_inner {
            compatible = "zmk,behavior-mod-morph";
            #binding-cells = <0>;
            bindings = <&kp LS(COMMA)>, <&kp LESS_THAN>;
            mods = <(MOD_LCTL | MOD_RCTL)>;
        };

        /* Dot: tap = . | shift = : (Swedish layout) */
        dot_morph: dot_morph {
            compatible = "zmk,behavior-mod-morph";
            #binding-cells = <0>;
            bindings = <&kp DOT>, <&dot_inner>;
            mods = <(MOD_LSFT | MOD_RSFT)>;
        };
        dot_inner: dot_inner {
            compatible = "zmk,behavior-mod-morph";
            #binding-cells = <0>;
            bindings = <&kp LS(DOT)>, <&kp GREATER_THAN>;
            mods = <(MOD_LCTL | MOD_RCTL)>;
        };

        /* Question/Exclamation: tap = ? (Shift+Plus) | shift = ! (Shift+1) */
        qexcl: qexcl {
            compatible = "zmk,behavior-mod-morph";
            #binding-cells = <0>;
            bindings = <&kp LS(EQUAL)>, <&kp LS(N1)>;
            mods = <(MOD_LSFT | MOD_RSFT)>;
        };

        /* Parentheses for Swedish: tap = ( | shift = < */
        lpar_lt: lpar_lt {
            compatible = "zmk,behavior-mod-morph";
            #binding-cells = <0>;
            bindings = <&kp LS(N8)>, <&kp LESS_THAN>;
            mods = <(MOD_LSFT | MOD_RSFT)>;
        };
        /* Parentheses for Swedish: tap = ) | shift = > */
        rpar_gt: rpar_gt {
            compatible = "zmk,behavior-mod-morph";
            #binding-cells = <0>;
            bindings = <&kp LS(N9)>, <&kp GREATER_THAN>;
            mods = <(MOD_LSFT | MOD_RSFT)>;
        };

        /* Brackets for Swedish: tap = [ | shift = { */
        lbkt_lbrc: lbkt_lbrc {
            compatible = "zmk,behavior-mod-morph";
            #binding-cells = <0>;
            bindings = <&kp LBKT>, <&kp LS(RBKT)>;
            mods = <(MOD_LSFT | MOD_RSFT)>;
        };
        /* Brackets for Swedish: tap = ] | shift = } */
        rbkt_rbrc: rbkt_rbrc {
            compatible = "zmk,behavior-mod-morph";
            #binding-cells = <0>;
            bindings = <&kp RBKT>, <&kp LS(LBKT)>;
            mods = <(MOD_LSFT | MOD_RSFT)>;
        };

        /* Backspace/Delete: tap = bspc | shift = del */
        bs_del: bs_del {
            compatible = "zmk,behavior-mod-morph";
            #binding-cells = <0>;
            bindings = <&kp BSPC>, <&kp DEL>;
            mods = <(MOD_LSFT | MOD_RSFT)>;
            keep-mods = <(MOD_RSFT)>;
        };

        /* Double quote/Single quote (Swedish): tap = " | shift = ' */
        dblquote_singlequote: dblquote_singlequote {
            compatible = "zmk,behavior-mod-morph";
            #binding-cells = <0>;
            bindings = <&kp LS(N2)>, <&kp SQT>;
            mods = <(MOD_LSFT | MOD_RSFT)>;
        };
    };
};

/*
 * Space with layer tap and sentence ending
 *
 * Tap: space
 * Shift + tap: dot + space + sticky shift (sentence ending)
 * Hold: nav layer
 */

/ {
    behaviors {
        lt_spc: lt_spc {
            compatible = "zmk,behavior-hold-tap";
            #binding-cells = <2>;
            flavor = "balanced";
            tapping-term-ms = <200>;
            quick-tap-ms = <QUICK_TAP_MS>;
            bindings = <&mo>, <&spc_morph>;
        };

        spc_morph: spc_morph {
            compatible = "zmk,behavior-mod-morph";
            #binding-cells = <0>;
            bindings = <&kp SPACE>, <&dot_spc>;
            mods = <(MOD_LSFT | MOD_RSFT)>;
        };

        /* Backspace/Delete with FN layer tap
         * Tap: backspace (or delete with shift)
         * Hold: FN layer
         */
        lt_bsdel: lt_bsdel {
            compatible = "zmk,behavior-hold-tap";
            #binding-cells = <2>;
            flavor = "balanced";
            tapping-term-ms = <200>;
            quick-tap-ms = <QUICK_TAP_MS>;
            bindings = <&mo>, <&bs_del>;
        };
    };

    macros {
        /* Dot + space + sticky shift for sentence ending */
        dot_spc: dot_spc {
            compatible = "zmk,behavior-macro";
            #binding-cells = <0>;
            wait-ms = <0>;
            tap-ms = <5>;
            bindings = <&kp DOT &kp SPACE &sk LSHFT>;
        };
    };
};

/*
 * Copy/Cut tap dance
 *
 * Tap: copy (Ctrl+C)
 * Double-tap: cut (Ctrl+X)
 */

/ {
    behaviors {
        copy_cut: copy_cut {
            compatible = "zmk,behavior-tap-dance";
            #binding-cells = <0>;
            tapping-term-ms = <200>;
            bindings = <&kp LC(C)>, <&kp LC(X)>;
        };
    };
};

/*
 * Navigation hold-taps for enhanced arrow keys
 */

/ {
    behaviors {
        /* Left: tap = left | hold = home */
        nav_left: nav_left {
            compatible = "zmk,behavior-hold-tap";
            #binding-cells = <2>;
            flavor = "tap-preferred";
            tapping-term-ms = <220>;
            quick-tap-ms = <220>;
            bindings = <&kp>, <&kp>;
        };

        /* Right: tap = right | hold = end */
        nav_right: nav_right {
            compatible = "zmk,behavior-hold-tap";
            #binding-cells = <2>;
            flavor = "tap-preferred";
            tapping-term-ms = <220>;
            quick-tap-ms = <220>;
            bindings = <&kp>, <&kp>;
        };
    };
};

/* Convenience aliases */
#define MAGIC_SHIFT &magic_shift LSHFT 0
#define SMART_NUM &smart_num NUM 0
#define NAV_SPC &lt_spc NAV 0
#define FN_BSDEL &lt_bsdel FN 0
#define NAV_LEFT &nav_left HOME LEFT
#define NAV_RIGHT &nav_right END RIGHT
#define NAV_BSPC &mt LC(BSPC) BSPC
#define NAV_DEL &mt LC(DEL) DEL
#define CANCEL &kp K_CANCEL
